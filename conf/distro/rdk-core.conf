## conf/layer.conf
```bitbake
# meta-core-rdk — next-generation Core RDK middleware layer
BBPATH .= ":${LAYERDIR}"

BBFILES += "${LAYERDIR}/recipes-*/*/*.bb \
            ${LAYERDIR}/recipes-*/*/*.bbappend \
            ${LAYERDIR}/recipes-*/*/*/*.bb \
            ${LAYERDIR}/recipes-*/*/*/*.bbappend"

BBFILE_COLLECTIONS += "core-rdk"
BBFILE_PATTERN_core-rdk = "^${LAYERDIR}/"
BBFILE_PRIORITY_core-rdk = "10"

LAYERDEPENDS_core-rdk = "core"
LAYERSERIES_COMPAT_core-rdk = "kirkstone"
```
